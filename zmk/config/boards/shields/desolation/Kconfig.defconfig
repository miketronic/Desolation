## zmk/config/boards/shields/desolation/Kconfig.defconfig
```kconfig
# Copyright (c) 2024 miketronic
# SPDX-License-Identifier: MIT

if SHIELD_DESOLATION

config ZMK_KEYBOARD_NAME
    default "Desolation"

endif
```

## zmk/config/boards/shields/desolation/Kconfig.shield
```kconfig
# Copyright (c) 2024 miketronic
# SPDX-License-Identifier: MIT

config SHIELD_DESOLATION
    def_bool $(shields_list_contains,desolation)
```

## zmk/config/west.yml
```yaml
manifest:
  remotes:
      # zmk official
    - name: zmkfirmware
      url-base: https://github.com/zmkfirmware
      # bravekarma
    - name: caksoylar
      url-base: https://github.com/caksoylar
  projects:
    - name: zmk
      # remote: zmkfirmware
      # revision: main
      remote: caksoylar
      revision: caksoylar/experimental
      import: app/west.yml
  self:
    path: config
```
